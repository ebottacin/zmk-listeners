## Kconfig
```kconfig
DT_COMPAT_ZMK_LAYER_LISTENERS := zmk,layer-listeners
DT_COMPAT_ZMK_KEYCODE_LISTENERS := zmk,keycode-listeners
DT_COMPAT_ZMK_HID_LISTENERS := zmk,hid-listeners

config ZMK_LAYER_LISTENERS
    bool
    default $(dt_compat_enabled,$(DT_COMPAT_ZMK_LAYER_LISTENERS))

config ZMK_KEYCODE_LISTENERS
    bool
    default $(dt_compat_enabled,$(DT_COMPAT_ZMK_KEYCODE_LISTENERS))

config ZMK_HID_LISTENERS
    bool
    default $(dt_compat_enabled,$(DT_COMPAT_ZMK_HID_LISTENERS))
```

## dts/bindings/zmk,hid-listeners.yaml
```yaml
# Copyright (c) 2025 The ZMK Contributors
# SPDX-License-Identifier: MIT

description: USB HID Indicator Listener

compatible: "zmk,hid-listeners"

properties:
  tap-ms:
    type: int
    description: Time to wait (in milliseconds) between the press and release events on a triggered listener behavior binding.
    default: 5
  wait-ms:
    type: int
    description: The default time to wait (in milliseconds) before triggering the next listener behavior binding.
    default: 5

child-binding:
  description: "A HID Indicator listener"
  properties:
    indicator:
      type: int
      required: true
    bindings:
      type: phandle-array
      required: true
```
